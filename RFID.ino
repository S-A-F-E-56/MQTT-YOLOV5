#include <SPI.h>
#include <MFRC522.h>
#include <Wire.h>
#include <Adafruit_GFX.h>
#include <Adafruit_SSD1306.h>
#include <WiFi.h>
#include <PubSubClient.h>

#define SS_PIN  5  // ESP32 pin GPIO5 
#define RST_PIN 27 // ESP32 pin GPIO27 

#define SCREEN_I2C_ADDR 0x3C // or 0x3C
#define SCREEN_WIDTH 128     // OLED display width, in pixels
#define SCREEN_HEIGHT 64     // OLED display height, in pixels
#define OLED_RST_PIN -1      // Reset pin (-1 if not available)

const char* ssid = "LANTAI 2";
const char* password = "12345678";

const char* mqtt_server = "broker.emqx.io";
const int mqtt_port = 1883;

const char* topic = "/SIC5/S.A.F.E/test/data";
const char* topicdua = "/SIC5/S.A.F.E/test/response";
const char* mqtt_username = "emqx";
const char* mqtt_password = "public";

// Buat objek WiFi
WiFiClient wifiClient;

// Buat objek PubSubClient
PubSubClient client(wifiClient);


Adafruit_SSD1306 display(SCREEN_WIDTH, SCREEN_HEIGHT, &Wire, OLED_RST_PIN);

#define FRAME_DELAY 42
#define FRAME_WIDTH 64
#define FRAME_HEIGHT 64

// Ketika Tag RFID Valid
const byte PROGMEM successFrames[][512] = {
  {0,0,0,0,0,0,0,0,0,0,0,0,0,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0,0},
  {0,0,0,0,0,0,0,0,0,0,0,0,0,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0,0},
  {0,0,0,0,0,0,0,0,0,0,0,0,0,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0,0},
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  {0,0,0,0,0,0,0,0,0,0,0,0,0,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0,0}
};

#define SUCCESS_FRAME_COUNT (sizeof(successFrames) / sizeof(successFrames[0]))

// Ketika Tag RFID Tidak Valid
const byte PROGMEM failFrames[][512] = {
  {0,0,0,0,0,0,0,0,3,128,0,0,0,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0,0},
  {0,0,0,0,0,0,0,0,3,128,0,0,0,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0,0},
  {0,0,0,0,0,0,0,0,3,128,0,0,0,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0,0},
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  {0,0,0,0,0,0,0,0,3,128,0,0,0,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0,0}
};

#define FAIL_FRAME_COUNT (sizeof(failFrames) / sizeof(failFrames[0]))

MFRC522 rfid(SS_PIN, RST_PIN);

// UID yang diijinkan 
// byte allowedUID[4] = {0xD3, 0x31, 0x17, 0x14};
byte allowedUID[4] = {227, 130, 198, 53};
byte allowedUID2[7] = {160, 51, 47, 10, 8, 48, 55};


void setup() {
  Serial.begin(9600);

  // Hubungkan ESP32 ke WiFi
  WiFi.begin(ssid, password);

  // Cek status koneksi
  while (WiFi.status() != WL_CONNECTED) {
    delay(500);
    Serial.print(".");

  Serial.println("");
  Serial.println("WiFi connected!");
  Serial.println("IP address: " + WiFi.localIP().toString());
  }

  client.setServer(mqtt_server, mqtt_port);
  client.setCallback(callback);

  while (!client.connected()) {
    Serial.println("Connecting to MQTT...");
    if (client.connect("ESP32", mqtt_username, mqtt_password)) {
      Serial.println("MQTT connected!");
    } else {
      Serial.print("failed, rc=");
      Serial.println(client.state());
      delay(5000);
    }
  }
  
  // Subscribe data
  client.subscribe(topic, 0);

  SPI.begin(); // init SPI bus
  rfid.PCD_Init(); // init MFRC522

  Serial.println("Tap an RFID/NFC tag on the RFID-RC522 reader");
  if (!display.begin(SSD1306_SWITCHCAPVCC, SCREEN_I2C_ADDR)) {
    Serial.println(F("SSD1306 allocation failed"));
    for (;;);
  }

  display.display();
  delay(2000); // Memberikan waktu untuk melihat layar inisialisasi
}

void loop() {
  client.loop();
  if (rfid.PICC_IsNewCardPresent()) { // terdeteksi tag baru
    if (rfid.PICC_ReadCardSerial()) { // NUID has been read
      // Print RFID/NFC Tag Type
      MFRC522::PICC_Type piccType = rfid.PICC_GetType(rfid.uid.sak);
      Serial.print("RFID/NFC Tag Type: ");
      Serial.println(rfid.PICC_GetTypeName(piccType));

      // Print UID ke Serial Monitor dalam format hex 
      Serial.print("UID:");
      for (int i = 0; i < rfid.uid.size; i++) {
        Serial.print(rfid.uid.uidByte[i] < 0x10 ? " 0" : " ");
        Serial.print(rfid.uid.uidByte[i]);
      }
      Serial.println();

      // Cek apakah UID sesuai dengan UID yang diijinkan
      if ( checkUID(rfid.uid.uidByte, allowedUID)  || checkUIDPart2(rfid.uid.uidByte, allowedUID2) ) {
        Serial.println("Tap Sukses");
        playAnimation(successFrames, SUCCESS_FRAME_COUNT, 3);

        const char* prefix = "Sukses - ";
        String numberString;
        for (int i = 0; i < sizeof(rfid.uid.uidByte); ++i) {
            numberString += String(rfid.uid.uidByte[i]);
        }
        const char* finalString = (prefix + numberString).c_str();
        client.publish(topicdua,finalString);
      } else {
        Serial.println("Tap Failed");
        playAnimation(failFrames, FAIL_FRAME_COUNT, 3); // Menampilkan animasi

        const char* prefix = "Gagal - ";
        String numberString;
        for (int i = 0; i < sizeof(rfid.uid.uidByte); ++i) {
            numberString += String(rfid.uid.uidByte[i]);
        }
        const char* finalString = (prefix + numberString).c_str();
        client.publish(topicdua,finalString);

      }
      rfid.PICC_HaltA(); // halt PICC
      rfid.PCD_StopCrypto1(); // stop encryption on PCD
    }
  }
}

bool checkUID(byte *readUID, byte *allowedUID) {
  for (int i = 0; i < 4; i++) {
    if (readUID[i] != allowedUID[i]) {
      return false;
    }
  }
  return true;
}


bool checkUIDPart2(byte *readUID, byte *allowedUID2) {
  for (int i = 0; i < 7; i++) {
    if (readUID[i] != allowedUID2[i]) {
      return false;
    }
  }
  return true;
}

void playAnimation(const byte frames[][512], int frameCount, int repeatCount) {
  for (int count = 0; count < repeatCount; count++) {
    for (int frame = 0; frame < frameCount; frame++) {
      display.clearDisplay();
      display.drawBitmap(32, 0, frames[frame], FRAME_WIDTH, FRAME_HEIGHT, 1);
      display.display();
      delay(FRAME_DELAY);
    }
  }
}

// Callback ketika ada pesan yang diterima dari broker
void callback(char* topic, byte* payload, unsigned int length) {
  // Tampilkan pesan yang diterima
  Serial.print("Received topic: ");
  Serial.println(topic);
  Serial.print("Received payload: ");
  for (int i = 0; i < length; i++) {
    Serial.print((char)payload[i]);
  }
  Serial.println();
}
